#include "ssd1306_stm32.h"
#include "I2C1_WriteByte_DMA.h"
extern void i2c_writeByte(uint8_t addr, uint8_t reg, uint8_t data);

static uint8_t SSD1306_Buffer[SSD1306_WIDTH * SSD1306_HEIGHT / 8];

static const uint8_t Font5x7[][5] = {
    {0x00,0x00,0x00,0x00,0x00}, // space
    {0x00,0x00,0x5F,0x00,0x00}, // !
    {0x00,0x07,0x00,0x07,0x00}, // "
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    {0x61,0x51,0x49,0x45,0x43}, // Z
};

static void ssd1306_command(uint8_t c) { i2c_writeByte(SSD1306_ADDR, 0x00, c); }
static void ssd1306_data(uint8_t d) { i2c_writeByte(SSD1306_ADDR, 0x40, d); }

void SSD1306_Init(void){
    ssd1306_command(0xAE); 
    ssd1306_command(0x20); ssd1306_command(0x00);
    ssd1306_command(0xB0); ssd1306_command(0xC8);
    ssd1306_command(0x00); ssd1306_command(0x10);
    ssd1306_command(0x40); ssd1306_command(0x81); ssd1306_command(0xFF);
    ssd1306_command(0xA1); ssd1306_command(0xA6);
    ssd1306_command(0xA8); ssd1306_command(0x3F);
    ssd1306_command(0xA4); ssd1306_command(0xD3); ssd1306_command(0x00);
    ssd1306_command(0xD5); ssd1306_command(0xF0);
    ssd1306_command(0xD9); ssd1306_command(0x22);
    ssd1306_command(0xDA); ssd1306_command(0x12);
    ssd1306_command(0xDB); ssd1306_command(0x20);
    ssd1306_command(0x8D); ssd1306_command(0x14);
    ssd1306_command(0xAF); 
}

void SSD1306_Clear(void){
    for(int i=0;i<sizeof(SSD1306_Buffer);i++) SSD1306_Buffer[i]=0;
}

void SSD1306_UpdateScreen(void){
    for(uint8_t page=0; page<8; page++){
        ssd1306_command(0xB0 + page);
        ssd1306_command(0x00);
        ssd1306_command(0x10);
        for(uint8_t col=0; col<SSD1306_WIDTH; col++){
            ssd1306_data(SSD1306_Buffer[page*SSD1306_WIDTH + col]);
        }
    }
}

void SSD1306_UpdateScreen_DMA(void){
    for(uint8_t page = 0; page < 8; page++){
        ssd1306_command(0xB0 + page); 
        ssd1306_command(0x00);        
        ssd1306_command(0x10);        

        
        i2c_writeBytes_DMA(SSD1306_ADDR, 0x40, &SSD1306_Buffer[page * SSD1306_WIDTH], SSD1306_WIDTH);
    }
}

void SSD1306_DrawChar(uint8_t x, uint8_t y, char c){
    if(c<32 || c>127) c='?';
    for(uint8_t i=0;i<5;i++)
        SSD1306_Buffer[x + (y/8)*SSD1306_WIDTH + i] = Font5x7[c-32][i];
    SSD1306_Buffer[x + (y/8)*SSD1306_WIDTH + 5] = 0x00;
}

void SSD1306_DrawString(uint8_t x, uint8_t y, const char* str){
    while(*str){
        SSD1306_DrawChar(x,y,*str++);
        x+=6;
        if(x+6>SSD1306_WIDTH){ x=0; y+=8; }
    }
}

void SSD1306_DrawPixel(uint8_t x, uint8_t y, uint8_t color){
    if(x >= SSD1306_WIDTH || y >= SSD1306_HEIGHT) return;

    if(color)
        SSD1306_Buffer[x + (y/8)*SSD1306_WIDTH] |= 1 << (y % 8);
    else
        SSD1306_Buffer[x + (y/8)*SSD1306_WIDTH] &= ~(1 << (y % 8));
}

void SSD1306_DrawBitmap(uint8_t x, uint8_t y, const uint8_t *bitmap, uint8_t w, uint8_t h){
    for(uint8_t i=0; i<w; i++){
        for(uint8_t j=0; j<h; j++){
            uint8_t byte = bitmap[i + (j/8)*w];
            if(byte & (1 << (j % 8)))
                SSD1306_DrawPixel(x+i, y+j, 1);
            else
                SSD1306_DrawPixel(x+i, y+j, 0);
        }
    }
}
